/*
 * Copyright (c) 2020 Pete Johanson
 *
 * SPDX-License-Identifier: MIT
 */

#include "splitty.dtsi"

&kscan0 {
	col-gpios
		= <&gpio1 13 GPIO_ACTIVE_HIGH>
		, <&gpio1 3 GPIO_ACTIVE_HIGH>
		, <&gpio1 1 GPIO_ACTIVE_HIGH>
		, <&gpio1 2 GPIO_ACTIVE_HIGH>
		, <&gpio1 4 GPIO_ACTIVE_HIGH>
		, <&gpio1 6 GPIO_ACTIVE_HIGH>
		, <&gpio0 9 GPIO_ACTIVE_HIGH>
		, <&gpio0 10 GPIO_ACTIVE_HIGH>
		;
};

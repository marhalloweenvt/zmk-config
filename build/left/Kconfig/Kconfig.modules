## build/left/Kconfig/Kconfig.modules
```kconfig
menu "canopennode (/home/marhalloweenvt/zmk/modules/lib/canopennode)"
osource "$(ZEPHYR_CANOPENNODE_KCONFIG)"
config ZEPHYR_CANOPENNODE_MODULE
	bool
	default y
endmenu
menu "chre (/home/marhalloweenvt/zmk/modules/lib/chre)"
osource "/home/marhalloweenvt/zmk/modules/lib/chre/platform/zephyr/Kconfig"
config ZEPHYR_CHRE_MODULE
	bool
	default y
endmenu
menu "hal_espressif (/home/marhalloweenvt/zmk/modules/hal/espressif)"
osource "/home/marhalloweenvt/zmk/modules/hal/espressif/zephyr/Kconfig"
config ZEPHYR_HAL_ESPRESSIF_MODULE
	bool
	default y
endmenu
menu "hal_gigadevice (/home/marhalloweenvt/zmk/modules/hal/gigadevice)"
osource "$(ZEPHYR_HAL_GIGADEVICE_KCONFIG)"
config ZEPHYR_HAL_GIGADEVICE_MODULE
	bool
	default y
endmenu
menu "hal_nordic (/home/marhalloweenvt/zmk/modules/hal/nordic)"
osource "$(ZEPHYR_HAL_NORDIC_KCONFIG)"
config ZEPHYR_HAL_NORDIC_MODULE
	bool
	default y
endmenu
menu "hal_rpi_pico (/home/marhalloweenvt/zmk/modules/hal/rpi_pico)"
osource "$(ZEPHYR_HAL_RPI_PICO_KCONFIG)"
config ZEPHYR_HAL_RPI_PICO_MODULE
	bool
	default y
endmenu
menu "hal_telink (/home/marhalloweenvt/zmk/modules/hal/telink)"
osource "/home/marhalloweenvt/zmk/modules/hal/telink/Kconfig"
config ZEPHYR_HAL_TELINK_MODULE
	bool
	default y
endmenu
menu "liblc3 (/home/marhalloweenvt/zmk/modules/lib/liblc3)"
osource "$(ZEPHYR_LIBLC3_KCONFIG)"
config ZEPHYR_LIBLC3_MODULE
	bool
	default y
endmenu
menu "littlefs (/home/marhalloweenvt/zmk/modules/fs/littlefs)"
osource "$(ZEPHYR_LITTLEFS_KCONFIG)"
config ZEPHYR_LITTLEFS_MODULE
	bool
	default y
endmenu
menu "lvgl (/home/marhalloweenvt/zmk/modules/lib/gui/lvgl)"
osource "/home/marhalloweenvt/zmk/modules/lib/gui/lvgl/zephyr/Kconfig"
config ZEPHYR_LVGL_MODULE
	bool
	default y
endmenu
menu "lz4 (/home/marhalloweenvt/zmk/modules/lib/lz4)"
osource "$(ZEPHYR_LZ4_KCONFIG)"
config ZEPHYR_LZ4_MODULE
	bool
	default y
endmenu
menu "mbedtls (/home/marhalloweenvt/zmk/modules/crypto/mbedtls)"
osource "$(ZEPHYR_MBEDTLS_KCONFIG)"
config ZEPHYR_MBEDTLS_MODULE
	bool
	default y
endmenu
menu "nanopb (/home/marhalloweenvt/zmk/modules/lib/nanopb)"
osource "$(ZEPHYR_NANOPB_KCONFIG)"
config ZEPHYR_NANOPB_MODULE
	bool
	default y
endmenu
menu "picolibc (/home/marhalloweenvt/zmk/modules/lib/picolibc)"
osource "/home/marhalloweenvt/zmk/modules/lib/picolibc/zephyr/Kconfig"
config ZEPHYR_PICOLIBC_MODULE
	bool
	default y
endmenu
menu "tflite-micro (/home/marhalloweenvt/zmk/modules/lib/tflite-micro)"
osource "$(ZEPHYR_TFLITE_MICRO_KCONFIG)"
config ZEPHYR_TFLITE_MICRO_MODULE
	bool
	default y
endmenu
menu "TraceRecorder (/home/marhalloweenvt/zmk/modules/debug/TraceRecorder)"
osource "/home/marhalloweenvt/zmk/modules/debug/TraceRecorder/kernelports/Zephyr/Kconfig"
config ZEPHYR_TRACERECORDER_MODULE
	bool
	default y
endmenu
menu "trusted-firmware-a (/home/marhalloweenvt/zmk/modules/tee/tf-a/trusted-firmware-a)"
osource "$(ZEPHYR_TRUSTED_FIRMWARE_A_KCONFIG)"
config ZEPHYR_TRUSTED_FIRMWARE_A_MODULE
	bool
	default y
endmenu
menu "uoscore-uedhoc (/home/marhalloweenvt/zmk/modules/lib/uoscore-uedhoc)"
osource "$(ZEPHYR_UOSCORE_UEDHOC_KCONFIG)"
config ZEPHYR_UOSCORE_UEDHOC_MODULE
	bool
	default y
endmenu
menu "zcbor (/home/marhalloweenvt/zmk/modules/lib/zcbor)"
osource "$(ZEPHYR_ZCBOR_KCONFIG)"
config ZEPHYR_ZCBOR_MODULE
	bool
	default y
endmenu
menu "zscilib (/home/marhalloweenvt/zmk/modules/lib/zscilib)"
osource "/home/marhalloweenvt/zmk/modules/lib/zscilib/Kconfig.zscilib"
config ZEPHYR_ZSCILIB_MODULE
	bool
	default y
endmenu
menu "drivers (/home/marhalloweenvt/zmk/app/drivers)"
osource "/home/marhalloweenvt/zmk/app/drivers/Kconfig"
config ZEPHYR_DRIVERS_MODULE
	bool
	default y
endmenu
```

## build/left/Kconfig/Kconfig.shield.defconfig
```kconfig
osource "/home/marhalloweenvt/zmk/app/boards/shields/*/Kconfig.defconfig"
osource "/home/marhalloweenvt/zmk-config/config/boards/shields/*/Kconfig.defconfig"
```

## build/right/Kconfig/Kconfig.shield
```kconfig
osource "/home/marhalloweenvt/zmk/app/boards/shields/*/Kconfig.shield"
osource "/home/marhalloweenvt/zmk-config/config/boards/shields/*/Kconfig.shield"
```

## config/boards/arm/holyiot_nrf52840/Kconfig.board
```kconfig
config BOARD_HOLYIOT_NRF52840
	bool "holyiot_nrf52480"
	depends on SOC_NRF52840_QIAA
```

## config/boards/arm/holyiot_nrf52840/Kconfig.defconfig
```kconfig
if BOARD_HOLYIOT_NRF52840

config BOARD
	default "holyiot_nrf52480"

if USB_DEVICE_STACK

config USB_NRFX
    default y

endif # USB_DEVICE_STACK

config BT_CTLR
    default BT

endif # BOARD_HOLYIOT_NRF52840
```

## config/boards/shields/blued6x/Kconfig.defconfig
```kconfig
if SHIELD_BLUED6X

config ZMK_KEYBOARD_NAME
	default "blued6x"

config USB_DEVICE_MANUFACTURER
    	default "marhalloweenvt"

config BT_DIS_MANUF
    	default "marhalloweenvt"

endif
```

## config/boards/shields/sofle_nrf52840/Kconfig.defconfig
```kconfig
# Copyright (c) 2020 Ryan Cross
# SPDX-License-Identifier: MIT

if SHIELD_SOFLE_NRF52840_DONGLE

config ZMK_KEYBOARD_NAME
    default "Sofle ZMK dongle"
	
config ZMK_SPLIT_ROLE_CENTRAL
	default y

config ZMK_USB
	default y

endif


if SHIELD_SOFLE_NRF52840_LEFT || SHIELD_SOFLE_NRF52840_RIGHT

config ZMK_SPLIT_ROLE_CENTRAL
    default n

config ZMK_SPLIT_BLE_CENTRAL_BATTERY_LEVEL_FETCHING
	default y

endif

if SHIELD_SOFLE_NRF52840_LEFT || SHIELD_SOFLE_NRF52840_RIGHT || SHIELD_SOFLE_NRF52840_DONGLE

config ZMK_SPLIT
    default y

config ZMK_BLE
	default y

config ZMK_EXT_POWER
    default y

endif
```

## config/boards/shields/sofle_nrf52840/Kconfig.shield
```kconfig
# Copyright (c) 2020 Ryan Cross
# SPDX-License-Identifier: MIT

config SHIELD_SOFLE_NRF52840_LEFT
    def_bool $(shields_list_contains,sofle_nrf52840_left)

config SHIELD_SOFLE_NRF52840_RIGHT
    def_bool $(shields_list_contains,sofle_nrf52840_right)
```

## config/boards/shields/splitty/Kconfig.defconfig
```kconfig
if SHIELD_SPLITTY_LEFT

config ZMK_KEYBOARD_NAME
	default "Splitty nRF52840"

config ZMK_SPLIT_ROLE_CENTRAL
    default y

endif

if SHIELD_SPLITTY_LEFT || SHIELD_SPLITTY_RIGHT

config ZMK_SPLIT
    default y

endif
```

## config/boards/shields/splitty/Kconfig.shield
```kconfig
# Copyright (c) 2020 The ZMK Contributors
# SPDX-License-Identifier: MIT

config SHIELD_SPLITTY_LEFT
    def_bool $(shields_list_contains,splitty_left)

config SHIELD_SPLITTY_RIGHT
    def_bool $(shields_list_contains,splitty_right)
```
